## ph4_tuya_esp32bridge/firmware/main/Kconfig.projbuild
```kconfig
menu "PH4 Tuya ESP32 Bridge"

    menu "Tuya Cloud"
        config TUYA_PID
            string "Tuya Product ID (PID)"
            default ""
            help
                Product ID from Tuya IoT Developer Console.
                Go to: Cloud > Development > Create Product > Get PID.

        config TUYA_UUID
            string "Tuya Device UUID"
            default ""
            help
                Device UUID (20-char string) generated for this device.
                Go to: Cloud > Development > Devices > Add Device > UUID.

        config TUYA_AUTH_KEY
            string "Tuya Device Auth Key"
            default ""
            help
                Device Auth Key (32-char string) paired with the UUID above.

        config TUYA_SW_VERSION
            string "Firmware version string"
            default "1.0.0"
    endmenu

    menu "WiFi"
        config WIFI_SSID
            string "Default WiFi SSID"
            default ""
            help
                Default SSID - can be overridden at runtime via NVS.

        config WIFI_PASSWORD
            string "Default WiFi password"
            default ""

        config WIFI_DISABLE_AP
            bool "Disable provisioning AP mode"
            default n
            help
                When enabled, the device will never start the provisioning AP,
                even if WiFi credentials are missing or STA connection fails.
                Use this for deployed devices where the AP is not needed and
                must not be exposed (security hardening).
                Can be overridden at runtime via NVS (wifi.ap_disabled in JSON).

        config WIFI_AP_MODE_TIMEOUT_S
            int "AP provisioning mode timeout (seconds)"
            default 180
            range 30 3600
            depends on !WIFI_DISABLE_AP
            help
                Time to stay in AP mode waiting for provisioning.
                After timeout, reboots and tries STA with saved credentials.
    endmenu

    menu "Home Assistant MQTT"
        config HA_MQTT_HOST
            string "MQTT broker host"
            default "192.168.1.x"

        config HA_MQTT_PORT
            int "MQTT broker port"
            default 1883
            range 1 65535

        config HA_MQTT_USER
            string "MQTT username"
            default ""

        config HA_MQTT_PASS
            string "MQTT password"
            default ""

        config HA_MQTT_TOPIC_PREFIX
            string "MQTT topic prefix"
            default "ph4/bridge"
            help
                All topics will be prefixed with this.
                Switch: {prefix}/switch/{n}/set and /state
                Socket: {prefix}/socket/{n}/set and /state

        config HA_MQTT_KEEPALIVE_S
            int "MQTT keepalive (seconds)"
            default 60
    endmenu

    menu "Bridge Channels"
        config BRIDGE_SWITCH_COUNT
            int "Number of switch channels (HA -> Tuya)"
            default 16
            range 1 16
            help
                Mapped to Tuya DPs 1..N.
                HA sets state, Tuya/SmartLife reflects it.

        config BRIDGE_SOCKET_COUNT
            int "Number of socket channels (Tuya -> HA)"
            default 16
            range 1 16
            help
                Mapped to Tuya DPs 101..101+N-1.
                SmartLife triggers state, ESP32 forwards to HA via MQTT.

        config BRIDGE_SOCKET_DP_BASE
            int "Tuya DP base for socket channels"
            default 101
            help
                First DP ID used for socket channels.
                Switch channels always use DP 1..BRIDGE_SWITCH_COUNT.

        config BRIDGE_SOCKET_AUTO_RESET_MS
            int "Socket auto-reset delay (ms), 0=disabled"
            default 500
            range 0 10000
            help
                After forwarding a socket ON event to HA, reset the DP back to
                OFF after this many ms. This allows SmartLife to re-trigger the
                same socket again without toggling state manually.
                Set to 0 to disable auto-reset (socket stays in triggered state).
    endmenu

endmenu
```

## ph4_tuya_esp32bridge/firmware/sdkconfig.defaults
```kconfig
# ESP32-C6 target
CONFIG_IDF_TARGET="esp32c6"

# Partition table
CONFIG_PARTITION_TABLE_CUSTOM=y
CONFIG_PARTITION_TABLE_CUSTOM_FILENAME="partitions.csv"

# Flash size: 4MB
CONFIG_ESPTOOLPY_FLASHSIZE_4MB=y
CONFIG_ESPTOOLPY_FLASHSIZE="4MB"

# WiFi
CONFIG_ESP_WIFI_STATIC_RX_BUFFER_NUM=10
CONFIG_ESP_WIFI_DYNAMIC_RX_BUFFER_NUM=32
CONFIG_ESP_WIFI_TX_BUFFER_TYPE_DYNAMIC=y

# TCP/IP stack - larger buffers for TLS
CONFIG_LWIP_TCP_SND_BUF_DEFAULT=5744
CONFIG_LWIP_TCP_WND_DEFAULT=5744
CONFIG_LWIP_TCP_RECVMBOX_SIZE=6
CONFIG_LWIP_UDP_RECVMBOX_SIZE=6
CONFIG_LWIP_TCPIP_RECVMBOX_SIZE=32

# mbedTLS - needed for Tuya cloud TLS
CONFIG_MBEDTLS_INTERNAL_MEM_ALLOC=y
CONFIG_MBEDTLS_SSL_MAX_CONTENT_LEN=8192
CONFIG_MBEDTLS_CERTIFICATE_BUNDLE=y
CONFIG_MBEDTLS_CERTIFICATE_BUNDLE_DEFAULT_FULL=y

# MQTT component
CONFIG_MQTT_PROTOCOL_311=y
CONFIG_MQTT_TRANSPORT_SSL=y
CONFIG_MQTT_TRANSPORT_WEBSOCKET=n
CONFIG_MQTT_BUFFER_SIZE=4096
CONFIG_MQTT_OUTBOX_EXPIRED_TIMEOUT_MS=30000

# NVS
CONFIG_NVS_ENCRYPTION=n

# Logging
CONFIG_LOG_DEFAULT_LEVEL_INFO=y
CONFIG_LOG_DEFAULT_LEVEL=3

# FreeRTOS
CONFIG_FREERTOS_HZ=1000
CONFIG_FREERTOS_WATCHPOINT_END_OF_STACK=y

# Heap tracing (disable for production)
CONFIG_HEAP_CORRUPTION_DETECTION=y

# Main task stack size
CONFIG_ESP_MAIN_TASK_STACK_SIZE=8192

# System event loop
CONFIG_ESP_SYSTEM_EVENT_TASK_STACK_SIZE=4096

# Disable BT to save memory (not needed for this app)
CONFIG_BT_ENABLED=n

# Enable OTA
CONFIG_OTA_ALLOW_HTTP=n
```
